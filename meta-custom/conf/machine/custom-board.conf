## meta-custom/conf/machine/custom-board.conf
```bitbake
KERNEL_DEVICETREE = "aspeed/aspeed-ast2500-custom-board.dtb"

UBOOT_MACHINE = "evb-ast2500_defconfig"
UBOOT_DEVICETREE = "ast2500-evb"

# require conf/machine/evb-ast2500.conf
require conf/machine/include/ast2500.inc
require conf/machine/include/obmc-evb-common.inc

MACHINEOVERRIDES =. "custom-board:"

SERIAL_CONSOLES = "115200;ttyS4"

FLASH_SIZE = "65536"

OBMC_IMAGE_EXTRA_INSTALL:append = " \
    entity-manager \
    dbus-sensors \
    x86-power-control \
    mctp \
    "

IMAGE_INSTALL:append = " virtual-led-ctrl"

IMAGE_INSTALL:remove = " phosphor-hwmon \
    "

VIRTUAL-RUNTIME_obmc-inventory-manager = "entity-manager"
PREFERRED_PROVIDER_virtual/obmc-inventory-data = "entity-manager"

VIRTUAL-RUNTIME_obmc-host-state-manager ?= "x86-power-control"
VIRTUAL-RUNTIME_obmc-chassis-state-manager ?= "x86-power-control"

# Enable extra users support in the image
INHERIT += "extrausers"

# Add admin user to web services
PASSWD ?= "\$6\$tPPjpi0TVOj.biOP\$fZWQHcw2w6xMrFiPqfl4XYndOKyryMLiGM3PrtcwtiGeTyv6zFVjzKZ2TGxhGbiLlzF3IO9MlgxX3D2uBqksD0"
EXTRA_USERS_PARAMS:append:pn-obmc-phosphor-image = " \
    useradd -m -s /usr/sbin/nologin -G web,redfish,priv-admin admin; \
    usermod -p '${PASSWD}' admin; \
"
```
